## boards/shields/Kusa046RB/Kconfig.defconfig
```kconfig
if SHIELD_Kusa046RB

# Name must be less than 16 characters long!
config ZMK_KEYBOARD_NAME
    default "Kusa046RB"

endif
```

## config/boards/Kusa046RB.conf
```kconfig
CONFIG_ZMK_KEYBOARD_NAME="Kusa046RB"

# CONFIG_NFCT_PINS_AS_GPIOS=y
CONFIG_ZMK_BLE=y
CONFIG_ZMK_USB=y

CONFIG_EC11=y
CONFIG_EC11_TRIGGER_GLOBAL_THREAD=y

CONFIG_ZMK_KSCAN_DEBOUNCE_PRESS_MS=3
CONFIG_ZMK_KSCAN_DEBOUNCE_RELEASE_MS=3

CONFIG_ZMK_POINTING=y
```

## config/boards/shields/Kusa046RB/Kconfig.shield
```kconfig
# No whitespace after the comma or in your keyboard name!
config SHIELD_KUSA046RB
    def_bool $(shields_list_contains,kusa046rb)
```
